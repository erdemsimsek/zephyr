## samples/boards/nordic/system_off/boards/nrf54l15dk_nrf54l15_cpuapp_ns.conf
```kconfig
# Non-secure variant: enable the retained_mem driver so its System OFF retention
# is configured through the secure RAM-control service (CONFIG_NRF_TFM_RAM_CTRL_SERVICE
# is default-y on this target). The sample only configures retention and dumps
# MEMCONF; it does not read the retained region from the non-secure side.
CONFIG_APP_USE_RETAINED_MEM=y
```
